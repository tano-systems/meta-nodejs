## conf/layer.conf
```bitbake
# We have a conf and classes directory, append to BBPATH
BBPATH .= ":${LAYERDIR}"

# We have a recipes directory, add to BBFILES
BBFILES += "${LAYERDIR}/recipes*/*/*.bb ${LAYERDIR}/recipes*/*/*.bbappend"

BBFILE_COLLECTIONS += "nodejs"
BBFILE_PATTERN_nodejs := "^${LAYERDIR}/"
BBFILE_PRIORITY_nodejs = "45"

LAYERDEPENDS_nodejs = "core"

# Compatible with OE Release 2.5 (Sumo)
LAYERSERIES_COMPAT_nodejs = "sumo"
```
